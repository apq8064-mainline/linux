## Documentation/devicetree/bindings/display/msm/dsi-controller-main.yaml
```yaml
# SPDX-License-Identifier: GPL-2.0-only or BSD-2-Clause
%YAML 1.2
---
$id: http://devicetree.org/schemas/display/msm/dsi-controller-main.yaml#
$schema: http://devicetree.org/meta-schemas/core.yaml#

title: Qualcomm Display DSI controller

maintainers:
  - Krishna Manikandan <mkrishn@codeaurora.org>

properties:
  compatible:
    oneOf:
      - items:
          - enum:
              - qcom,dsi-ctrl-v2-apq8064
              - qcom,dsi-ctrl-6g-v1.0.0
              - qcom,dsi-ctrl-6g-v1.1.0
              - qcom,dsi-ctrl-6g-v1.1.1
              - qcom,dsi-ctrl-6g-v1.2.0
              - qcom,dsi-ctrl-6g-v1.3.0
              - qcom,dsi-ctrl-6g-v1.3.1
              - qcom,dsi-ctrl-6g-v1.4.1
              - qcom,dsi-ctrl-6g-v1.4.2
              - qcom,dsi-ctrl-6g-v2.1.0
              - qcom,dsi-ctrl-6g-v2.2.0
              - qcom,dsi-ctrl-6g-v2.2.1
              - qcom,dsi-ctrl-6g-v2.3.0
              - qcom,dsi-ctrl-6g-v2.4.0
              - qcom,dsi-ctrl-6g-v2.4.1
              - qcom,dsi-ctrl-6g-v2.5.0
          - const: qcom,mdss-dsi-ctrl

      - const: qcom,mdss-dsi-ctrl
        deprecated: true

  reg:
    maxItems: 1

  reg-names:
    const: dsi_ctrl

  interrupts:
    maxItems: 1

  clocks: true

  clock-names: true

  assigned-clocks: true

  assigned-clock-parents: true

  phys:
    maxItems: 1

  phy-names:
    const: dsi

  "#address-cells": true

  "#size-cells": true

  qcom,dual-dsi-mode:
    type: boolean
    description: >
      Indicates if the DSI controller is driving a panel which needs
      2 DSI links.

  power-domains:
    maxItems: 1

  operating-points-v2: true

  ports:
    $ref: "/schemas/graph.yaml#/properties/ports"
    description: |
      Contains DSI controller input and output ports as children, each
      containing one endpoint subnode.

    properties:
      port@0:
        $ref: "/schemas/graph.yaml#/$defs/port-base"
        unevaluatedProperties: false
        description: |
          Input endpoints of the controller.
        properties:
          endpoint:
            $ref: /schemas/media/video-interfaces.yaml#
            unevaluatedProperties: false
            properties:
              data-lanes:
                maxItems: 4
                minItems: 4
                items:
                  enum: [0, 1, 2, 3]

      port@1:
        $ref: "/schemas/graph.yaml#/$defs/port-base"
        unevaluatedProperties: false
        description: |
          Output endpoints of the controller.
        properties:
          endpoint:
            $ref: /schemas/media/video-interfaces.yaml#
            unevaluatedProperties: false
            properties:
              data-lanes:
                maxItems: 4
                minItems: 4
                items:
                  enum: [0, 1, 2, 3]

    required:
      - port@0
      - port@1

required:
  - compatible
  - reg
  - reg-names
  - interrupts
  - clocks
  - clock-names
  - phys
  - phy-names
  - assigned-clocks
  - assigned-clock-parents
  - ports

allOf:
  - $ref: "../dsi-controller.yaml#"
  # V2 and 6G definition:
  - if:
      properties:
        compatible:
          contains:
            pattern: '^qcom,dsi-ctrl-v2-[a-z0-9]+$'
    then:
      properties:
        clocks:
          minItems: 7
          maxItems: 7

        clock-names:
          items:
            - const: iface  # from dsi_v2_bus_clk_names
            - const: bus
            - const: core_mmss
            - const: src  # from dsi_clk_init_v2
            - const: byte  # from dsi_clk_init
            - const: pixel
            - const: core

        assigned-clocks:
          minItems: 4
          maxItems: 4
          description: >
            Parents of "byte", "esc", "src" and "pixel" for the given platform.

        assigned-clock-parents:
          minItems: 4
          maxItems: 4
          description: >
            The Byte, Escape, Source and Pixel clock PLL outputs provided by a DSI PHY block.

        syscon-sfpb:
          description: A phandle to mmss_sfpb syscon node.
          $ref: "/schemas/types.yaml#/definitions/phandle"

        avdd-supply:
          description: 3.0 V supply

        vdda-supply:
          description: 1.2 V supply

        vddio-supply:
          description: 1.8 V supply

  - if:
      properties:
        compatible:
          contains:
            pattern: '^qcom,dsi-ctrl-6g-v[0-9.]+$'
    then:
      properties:
        clocks:
          items:
            - description: Display byte clock
            - description: Display byte interface clock
            - description: Display pixel clock
            - description: Display escape clock
            - description: Display AHB clock
            - description: Display AXI clock

        clock-names:
          items:
            - const: byte
            - const: byte_intf
            - const: pixel
            - const: core
            - const: iface
            - const: bus

        assigned-clocks:
          minItems: 2
          maxItems: 2
          description: >
            Parents of "byte" and "pixel" for the given platform.

        assigned-clock-parents:
          minItems: 2
          maxItems: 2
          description: >
            The Byte and Pixel clock PLL outputs provided by a DSI PHY block.

      required:
        - power-domains
        - operating-points-v2

  # Specific 6G revisions:
  - if:
      properties:
        compatible:
          contains:
            pattern: '^qcom,dsi-ctrl-6g-v1.[0-2].[0-9.]+$'
    then:
      properties:
        vdd-supply:
          description: 3.0 V supply

        vdda-supply:
          description: 1.2 V supply

        vddio-supply:
          description: 1.8 V supply

  - if:
      properties:
        compatible:
          contains:
            const: qcom,dsi-ctrl-6g-v1.3.0
    then:
      properties:
        vcca-supply:
          description: 1.0 V supply

        vdd-supply:
          description: 1.8 V supply

        vdda-supply:
          description: 1.25 V supply

        vddio-supply:
          description: 1.8 V supply

      patternProperties:
        '^(lib_reg|ibb_reg)-supply$': true

  - if:
      properties:
        compatible:
          contains:
            const: qcom,dsi-ctrl-6g-v1.3.1
    then:
      properties:
        vdda-supply:
          description: 1.2 V supply

        vddio-supply:
          description: 1.8 V supply

  - if:
      properties:
        compatible:
          contains:
            const: qcom,dsi-ctrl-6g-v1.4.1
    then:
      properties:
        vcca-supply:
          description: 0.925 V supply

        vdda-supply:
          description: 1.25 V supply

        vddio-supply:
          description: 1.8 V supply

  - if:
      properties:
        compatible:
          contains:
            const: qcom,dsi-ctrl-6g-v1.4.2
    then:
      properties:
        vdda-supply:
          description: 1.2 V supply

        vddio-supply: true

  - if:
      properties:
        compatible:
          contains:
            const: qcom,dsi-ctrl-6g-v2.2.0
    then:
      properties:
        vdd-supply: true

        vdda-supply:
          description: 1.2 V supply

  - if:
      properties:
        compatible:
          contains:
            enum:
              - qcom,dsi-ctrl-6g-v2.1.0
              - qcom,dsi-ctrl-6g-v2.2.1
              - qcom,dsi-ctrl-6g-v2.3.0
              - qcom,dsi-ctrl-6g-v2.4.0
              - qcom,dsi-ctrl-6g-v2.4.1
              - qcom,dsi-ctrl-6g-v2.5.0
    then:
      properties:
        vdda-supply:
          description: 1.2 V supply

unevaluatedProperties: false

examples:
  - |
     #include <dt-bindings/interrupt-controller/arm-gic.h>
     #include <dt-bindings/clock/qcom,dispcc-sdm845.h>
     #include <dt-bindings/clock/qcom,gcc-sdm845.h>
     #include <dt-bindings/power/qcom-rpmpd.h>

     dsi@ae94000 {
           compatible = "qcom,mdss-dsi-ctrl";
           reg = <0x0ae94000 0x400>;
           reg-names = "dsi_ctrl";

           #address-cells = <1>;
           #size-cells = <0>;

           interrupt-parent = <&mdss>;
           interrupts = <4>;

           clocks = <&dispcc DISP_CC_MDSS_BYTE0_CLK>,
                    <&dispcc DISP_CC_MDSS_BYTE0_INTF_CLK>,
                    <&dispcc DISP_CC_MDSS_PCLK0_CLK>,
                    <&dispcc DISP_CC_MDSS_ESC0_CLK>,
                    <&dispcc DISP_CC_MDSS_AHB_CLK>,
                    <&dispcc DISP_CC_MDSS_AXI_CLK>;
           clock-names = "byte",
                         "byte_intf",
                         "pixel",
                         "core",
                         "iface",
                         "bus";

           phys = <&dsi0_phy>;
           phy-names = "dsi";

           assigned-clocks = <&dispcc DISP_CC_MDSS_BYTE0_CLK_SRC>,
                             <&dispcc DISP_CC_MDSS_PCLK0_CLK_SRC>;
           assigned-clock-parents = <&dsi_phy 0>, <&dsi_phy 1>;

           power-domains = <&rpmhpd SC7180_CX>;
           operating-points-v2 = <&dsi_opp_table>;

           ports {
                  #address-cells = <1>;
                  #size-cells = <0>;

                  port@0 {
                          reg = <0>;
                          dsi0_in: endpoint {
                                   remote-endpoint = <&dpu_intf1_out>;
                          };
                  };

                  port@1 {
                          reg = <1>;
                          dsi0_out: endpoint {
                                   remote-endpoint = <&sn65dsi86_in>;
                                   data-lanes = <0 1 2 3>;
                          };
                  };
           };
     };
...
```

## Documentation/devicetree/bindings/leds/backlight/ti,lm3530.yaml
```yaml
# SPDX-License-Identifier: (GPL-2.0-only OR BSD-2-Clause)
%YAML 1.2
---
$id: http://devicetree.org/schemas/leds/backlight/ti,lm3530.yaml#
$schema: http://devicetree.org/meta-schemas/core.yaml#

title: Texas Instrument LM3530 backlight

maintainers:
  - Ivan Belokobylskiy <belokobylskij@gmail.com>

description: |
  The Texas Instruments LM3530 is white LED backlight.

allOf:
  - $ref: common.yaml#

properties:
  compatible:
    const: ti,lm3530

  enable-gpios:
    description: GPIO to use to enable/disable and dim the backlight.
    maxItems: 1

  default-brightness: true

  max-brightness: true

  ramp-up-ms:
    description: >
        The Run time ramp rates/step are from one current
        set-point to another after the device has reached its
        initial target set point from turn-on
    minimum: 0
    maximum: 8192

  ramp-down-ms:
    description: >
        The Run time ramp rates/step are from one current
        set-point to another after the device has reached its
        initial target set point from turn-on
    minimum: 0
    maximum: 8192

  ti,led-mode:
    $ref: /schemas/types.yaml#/definitions/uint8
    description: what mode ? FIXME.

  ti,current-limit:
    $ref: /schemas/types.yaml#/definitions/uint8
    description: >
      initial maximum current charger can pull from
      power supply in ?? FIXME. (also then new name could be
      current-limit-microvolt/milivolt ? TODO FIXME

  ti,linear-mapping-mode:
    $ref: /schemas/types.yaml#/definitions/uint8
    description: |
      Enable linear mapping mode. If disabled, then it will use exponential
      mapping mode in which the ramp up/down appears to have a more uniform
      transition to the human eye.


  ti,no-regulator:
    description: FIXME TODO, maybe we could deprecated this option at all
      and adjust driver to just print there is no regulator and continue?
    type: boolean

required:
  - compatible
  - enable-gpios
  - ti,led-mode
  - ti,current-limit
  - ti,linear-mapping-mode
  - max-brightness
  - default-brightness

additionalProperties: false

examples:
  - |
    #include <dt-bindings/gpio/gpio.h>
    backlight {
        compatible = "ti,lm3530";
        enable-gpios = <&gpio2 5 GPIO_ACTIVE_HIGH>;
        default-brightness = <0x10>;
        max-brightness = <0x72>;
        ramp-up-ms = <8>;
        ramp-down-ms = <8>;
        ti,current-limit = /bits/ 8 <0x17>;
        ti,led-mode = /bits/ 8 <0>;
        ti,linear-mapping-mode = /bits/ 8 <0>;
        ti,no-regulator;
    };
```
