## Documentation/devicetree/bindings/mfd/ti,lm3533.yaml
```yaml
# SPDX-License-Identifier: (GPL-2.0-only OR BSD-2-Clause)
%YAML 1.2
---
$id: http://devicetree.org/schemas/mfd/ti,lm3533.yaml#
$schema: http://devicetree.org/meta-schemas/core.yaml#

title: TI LM3533 LED driver

maintainers:
  - Wouter Franken <wouter.franken@gmail.com>

properties:
  compatible:
    const: ti,lm3533

  reg:
    description: I2C slave address
    maxItems: 1

  hwen-gpios:
    description:
      Reference to gpio pin connected to the HWEN input
    maxItems: 1

  als-supply:
    description:
      reference to regulator powering the V_als input

  boost-freq-hz:
    description:
      switch-frequency of the boost converter
    enum:
      - 500000
      - 1000000

  boost-ovp-microvolt:
    description:
      Over voltage protection limit
    enum:
      - 16000000
      - 24000000
      - 32000000
      - 40000000

  '#address-cells':
    const: 1

  '#size-cells':
    const: 0

  als:
    description: ALS related properties.
    type: object

    properties:
      ti,als-resistance-ohms:
        description: The resistor value (R_als).
        minimum: 1574
        maximum: 200000

      ti,pwm-mode:
        description: >
          Specifies, if present, that the als should
          operate in pwm mode - rather than analog mode.
        type: boolean

required:
  - compatible
  - reg
  - hwen-gpios
  - ti,boost-freq-khz
  - ti,boost-ovp
  - '#address-cells'
  - '#size-cells'

patternProperties:
  "^backlight@[01]$":
    description: Backlight related properties.
    type: object

    properties:
      reg:
        description:
          To which of two backlight nodes this corresponds to.
        maxItems: 1

      default-brightness:
        description:
          The default brightness for the backlight.
        minimum: 0
        maximum: 255
        $ref: types.yaml#/definitions/uint8

      label:
        description: Name for this backlight.
        maxItems: 1

      led-max-microamp:
        description:
          The max current for this backlight.

      ti,pwm-zones:
        description:
          Lists the ALS zones to be PWM controlled for this backlight.
        minimum: 0
        maximum: 4
        $ref: types.yaml#/definitions/uint32-array

    required:
      - reg
      - label
      - led-max-microamp

  "^led@[0123]$":
    description: LED related properties.
    type: object

    properties:
      reg:
        description: Which of four LED nodes this corresponds to.
        maxItems: 1

      linux,default-trigger:
        description: The default trigger for the LED.

      label:
        description: Name of this LED.
        maxItems: 1

      led-max-microamp:
        description: The max current for this LED.

      ti,pwm-zones:
        description:
          Lists the ALS zones to be PWM controlled for this LED.
        minimum: 0
        maximum: 4
        $ref: types.yaml#/definitions/uint32-array

    required:
      - reg
      - label
      - led-max-microamp

additionalProperties: false

examples:
  - |
    #include <dt-bindings/gpio/gpio.h>

    i2c@12460000 {
        compatible = "qcom,i2c-qup-v1.1.1";

        lm3533@36 {
            compatible = "ti,lm3533";
            reg = <0x36>;

            hwen-gpios = <&pm8921_gpio 26 GPIO_ACTIVE_HIGH>;
            als-supply = <&pm8921_l11>;

            ti,boost-freq-hz = <500000>;
            ti,boost-ovp-microvolt = <24000000>;

            #address-cells = <1>;
            #size-cells = <0>;

            als {
                ti,als-resistance-ohm = <200000>;
            };

            backlight@0 {
                reg = <0>;
                label = "backlight";

                led-max-microamp = <20200>;
            };

            led@0 {
                reg = <0>;
                label = "red";

                led-max-microamp = <5000>;
            };

            led@1 {
                reg = <1>;
                label = "green";

                led-max-microamp = <5000>;
            };

            led@2 {
                reg = <2>;
                label = "blue";

                led-max-microamp = <5000>;
            };
    };
```

## Documentation/devicetree/bindings/regulator/qcom,smd-rpm-regulator-common.yaml
```yaml
# SPDX-License-Identifier: GPL-2.0-only
%YAML 1.2
---
$id: http://devicetree.org/schemas/regulator/qcom,smd-rpm-regulator-common.yaml#
$schema: http://devicetree.org/meta-schemas/core.yaml#

title: Qualcomm SMD RPM Regulators

description:
  The Qualcomm RPM over SMD regulator is modelled as a subdevice of the RPM.
  Because SMD is used as the communication transport mechanism, the RPM
  resides as a subnode of the SMD.  As such, the SMD-RPM regulator requires
  that the SMD and RPM nodes be present.

maintainers:
  - Bjorn Andersson <bjorn.andersson@linaro.org>

properties:
  s0:
    $ref: "#/$defs/s"

  s1:
    $ref: "#/$defs/s"

  s2:
    $ref: "#/$defs/s"

  s3:
    $ref: "#/$defs/s"

  s4:
    $ref: "#/$defs/s"

  s5:
    $ref: "#/$defs/s"

  s7:
    $ref: "#/$defs/s"

  s8:
    $ref: "#/$defs/s"

  l1:
    $ref: "#/$defs/l"

  l2:
    $ref: "#/$defs/l"

  l3:
    $ref: "#/$defs/l"

  l4:
    $ref: "#/$defs/l"

  l5:
    $ref: "#/$defs/l"

  l6:
    $ref: "#/$defs/l"

  l7:
    $ref: "#/$defs/l"

  l8:
    $ref: "#/$defs/l"

  l9:
    $ref: "#/$defs/l"

  l10:
    $ref: "#/$defs/l"

  l11:
    $ref: "#/$defs/l"

  l12:
    $ref: "#/$defs/l"

  l13:
    $ref: "#/$defs/l"

  l14:
    $ref: "#/$defs/l"

  l15:
    $ref: "#/$defs/l"

  l16:
    $ref: "#/$defs/l"

  l17:
    $ref: "#/$defs/l"

  l18:
    $ref: "#/$defs/l"

  l19:
    $ref: "#/$defs/l"

  l20:
    $ref: "#/$defs/l"

  l21:
    $ref: "#/$defs/l"

  l22:
    $ref: "#/$defs/l"

  l23:
    $ref: "#/$defs/l"

  l24:
    $ref: "#/$defs/l"

  l25:
    $ref: "#/$defs/l"

  l26:
    $ref: "#/$defs/l"

  l27:
    $ref: "#/$defs/l"

  l28:
    $ref: "#/$defs/l"

  l29:
    $ref: "#/$defs/l"

  lvs0:
    $ref: "#/$defs/l"

  lvs1:
    $ref: "#/$defs/l"

  lvs2:
    $ref: "#/$defs/l"

  lvs3:
    $ref: "#/$defs/l"

  lvs4:
    $ref: "#/$defs/l"

  lvs5:
    $ref: "#/$defs/l"

  lvs6:
    $ref: "#/$defs/l"

  lvs7:
    $ref: "#/$defs/l"

  hdmi-switch:
    $ref: "#/$defs/l"

  usb-switch:
    $ref: "#/$defs/l"

  mvs:
    $ref: "#/$defs/l"

$defs:
  qcom,switch-mode-frequency:
    $ref: /schemas/types.yaml#/definitions/uint32
    description: >
      Frequency for switching modes  # FIXME

    enum: [19200000, 9600000, 6400000, 4800000,
           3840000, 3200000, 2740000, 2400000,
           2130000, 1920000, 1750000, 1600000,
           1480000, 1370000, 1280000, 1200000]

  s:
    type: object
    description: regulator  # FIXME
    $ref: "regulator.yaml#"

    properties:
      qcom,switch-mode-frequency:
        $ref: "#/$defs/qcom,switch-mode-frequency"

      qcom,force-mode:
        $ref: "/schemas/types.yaml#/definitions/uint32"
        description: >
          Forced mode  # FIXME

        enum:
          - 0  # QCOM_RPM_FORCE_MODE_NONE: do not force
          - 1  # QCOM_RPM_FORCE_MODE_LPM: force low power mode
          - 2  # QCOM_RPM_FORCE_MODE_HPM: force high power mode
          - 3  # QCOM_RPM_FORCE_MODE_AUTO: reg. sel. it's own mode based on realtime current draw

      qcom,power-mode-hysteretic:
        type: boolean
        description: >
          select that the power supply should operate in
          hysteretic mode, instead of the default PWM mode

    required:
      - qcom,switch-mode-frequency

  ncp:
    type: object
    $ref: "regulator.yaml#"
    description: Negative Charge Pump regulator
    properties:
      qcom,switch-mode-frequency:
        $ref: "#/$defs/qcom,switch-mode-frequency"

    required:
      - qcom,switch-mode-frequency

  l:
    type: object
    $ref: "regulator.yaml#"
    description: Linear Voltage or other switch regulator  # FIXME

    properties:
      qcom,force-mode:
        $ref: "/schemas/types.yaml#/definitions/uint32"
        description: >
          Forced mode  # FIXME

        enum:   # FIXME
          - 0  # QCOM_RPM_FORCE_MODE_NONE: do not force
          - 1  # QCOM_RPM_FORCE_MODE_LPM: force low power mode
          - 2  # QCOM_RPM_FORCE_MODE_HPM: force high power mode
          - 4  # QCOM_RPM_FORCE_MODE_BYPASS: act as a switch and not regulate


additionalProperties: true
unevaluatedProperties: false

required:
  - compatible
```

## Documentation/devicetree/bindings/regulator/qcom,smd-rpm-regulator-pm8018.yaml
```yaml
# SPDX-License-Identifier: GPL-2.0-only
%YAML 1.2
---
$id: http://devicetree.org/schemas/regulator/qcom,smd-rpm-regulator-pm8018.yaml#
$schema: http://devicetree.org/meta-schemas/core.yaml#

title: Qualcomm SMD RPM Regulator PM8018

maintainers:
  - Bjorn Andersson <bjorn.andersson@linaro.org>

allOf:
  - $ref: qcom,smd-rpm-regulator-common.yaml#

properties:
  compatible:
    const: qcom,rpm-pm8018-regulators

  s1: true
  s2:
    $ref: "qcom,smd-rpm-regulator-common.yaml#/$defs/s"
  s3: true
  s4: true
  s5: true

  l2: true
  l3: true
  l4: true
  l5: true
  l6: true
  l7: true
  l8: true
  l9: true
  l10: true
  l11: true
  l12: true
  l14: true

  lvs1: true

  vdd_s1-supply: true
  vdd_s2-supply: true
  vdd_s3-supply: true
  vdd_s4-supply: true
  vdd_s5-supply: true

  vdd_l2-supply: true
  vdd_l3-supply: true
  vdd_l4-supply: true
  vdd_l5-supply: true
  vdd_l7-supply: true
  vdd_l8-supply: true
  vdd_l9_l10_l11_l12-supply: true
  vdd_l14-supply: true

  lvs1_in-supply: true

unevaluatedProperties: false
```

## Documentation/devicetree/bindings/regulator/qcom,smd-rpm-regulator-pm8058.yaml
```yaml
# SPDX-License-Identifier: GPL-2.0-only
%YAML 1.2
---
$id: http://devicetree.org/schemas/regulator/qcom,smd-rpm-regulator-pm8058.yaml#
$schema: http://devicetree.org/meta-schemas/core.yaml#

title: Qualcomm SMD RPM Regulator PM8058

maintainers:
  - Bjorn Andersson <bjorn.andersson@linaro.org>

allOf:
  - $ref: qcom,smd-rpm-regulator-common.yaml#

properties:
  compatible:
    const: qcom,rpm-pm8058-regulators

  s0: true
  s1: true
  s2: true
  s3: true
  s4: true

  l0: true
  l1: true
  l2: true
  l3: true
  l4: true
  l5: true
  l6: true
  l7: true
  l8: true
  l9: true
  l10: true
  l11: true
  l12: true
  l13: true
  l14: true
  l15: true
  l16: true
  l17: true
  l18: true
  l19: true
  l20: true
  l21: true
  l22: true
  l23: true
  l24: true
  l25: true

  lvs0: true
  lvs1: true

  ncp: true

  vdd_l0_l1_lvs-supply: true
  vdd_l2_l11_l12-supply: true
  vdd_l3_l4_l5-supply: true
  vdd_l6_l7-supply: true
  vdd_l8-supply: true
  vdd_l9-supply: true
  vdd_l10-supply: true
  vdd_l13_l16-supply: true
  vdd_l14_l15-supply: true
  vdd_l17_l18-supply: true
  vdd_l19_l20-supply: true
  vdd_l21-supply: true
  vdd_l22-supply: true
  vdd_l23_l24_l25-supply: true

  vdd_s0-supply: true
  vdd_s1-supply: true
  vdd_s2-supply: true
  vdd_s3-supply: true
  vdd_s4-supply: true

  vdd_ncp-supply: true

unevaluatedProperties: false
```

## Documentation/devicetree/bindings/soc/qcom/qcom,saw2.yaml
```yaml
# SPDX-License-Identifier: GPL-2.0-only
%YAML 1.2
---
$id: "http://devicetree.org/schemas/soc/qcom/qcom,saw2.yaml#"
$schema: "http://devicetree.org/meta-schemas/core.yaml#"

title: Qualcomm SPM AVS Wrapper 2 (SAW2)

maintainers:
  - Bjorn Andersson <bjorn.andersson@linaro.org>

description: |
  The SAW2 is a wrapper around the Subsystem Power Manager (SPM) and the
  Adaptive Voltage Scaling (AVS) hardware. The SPM is a programmable
  power-controller that transitions a piece of hardware (like a processor or
  subsystem) into and out of low power modes via a direct connection to
  the PMIC. It can also be wired up to interact with other processors in the
  system, notifying them when a low power state is entered or exited.

  Multiple revisions of the SAW hardware are supported using these Device Nodes.
  SAW2 revisions differ in the register offset and configuration data. Also, the
  same revision of the SAW in different SoCs may have different configuration
  data due the differences in hardware capabilities. Hence the SoC name, the
  version of the SAW hardware in that SoC and the distinction between cpu (big
  or Little) or cache, may be needed to uniquely identify the SAW register
  configuration and initialization data. The compatible string is used to
  indicate this parameter.

properties:
  compatible:
    oneOf:
      - items:
          - enum:
              - qcom,apq8064-saw2-v1.1-cpu
              - qcom,msm8226-saw2-v2.1-cpu
              - qcom,msm8974-saw2-v2.1-cpu
              - qcom,apq8084-saw2-v2.1-cpu
          - const: qcom,saw2
      - items:
          const: qcom,saw2

  reg:
    minItems: 1
    items:
      - description: register region
      - description: alias register region

  regulator:
    type: boolean
    description: >
      Indicates that this SPM device acts as a regulator device
      device for the core (CPU or Cache) the SPM is attached to.

  '#power-domain-cells':
    const: 0

required:
  - compatible
  - reg

additionalProperties: false

examples:
  - |
    power-controller@2099000 {
        compatible = "qcom,saw2";
        reg = <0x02099000 0x1000>, <0x02009000 0x1000>;
        #power-domain-cells = <0>;
        regulator;
    };
  - |
    saw0: power-controller@f9089000 {
        compatible = "qcom,apq8084-saw2-v2.1-cpu", "qcom,saw2";
        reg = <0xf9089000 0x1000>, <0xf9009000 0x1000>;
        #power-domain-cells = <0>;
    };
```

## Documentation/devicetree/bindings/watchdog/qcom-wdt.yaml
```yaml
# SPDX-License-Identifier: (GPL-2.0-only OR BSD-2-Clause)
%YAML 1.2
---
$id: http://devicetree.org/schemas/watchdog/qcom-wdt.yaml#
$schema: http://devicetree.org/meta-schemas/core.yaml#

title: Qualcomm Krait Processor Sub-system (KPSS) Watchdog timer

maintainers:
  - Sai Prakash Ranjan <saiprakash.ranjan@codeaurora.org>

allOf:
  - if:
      properties:
        compatible:
          contains:
            const: qcom,msm-timer
    then:
      properties:
        $nodename:
          pattern: '^timer@[a-f0-9]+$'

        interrupts:
          minItems: 1
          items:
            - description: 1st purpose timer
            - description: 2nd general purpose timer
            - description: 1st watchdog interrupt
            - description: 2nd watchdog interrupt
            - description: 3nd watchdog interrupt

        cpu-offset:
          $ref: /schemas/types.yaml#/definitions/uint32
          description: >
            Per-cpu offset used when the timer is accessed without the
            CPU remapping facilities. The offset is cpu-offset + (0x10000 * cpu-nr).

      required:
        - interrupts
        - clock-frequency

    else:
      $ref: watchdog.yaml#
      properties:
        interrupts:
          maxItems: 1

        cpu-offset: false

        timeout-sec: true

      required:
        - clocks

      unevaluatedProperties: false

properties:
  compatible:
    minItems: 1
    maxItems: 3
    items:
      enum:
        - qcom,apss-wdt-qcs404
        - qcom,apss-wdt-sc7180
        - qcom,apss-wdt-sc7280
        - qcom,apss-wdt-sdm845
        - qcom,apss-wdt-sdx55
        - qcom,apss-wdt-sm6350
        - qcom,apss-wdt-sm8150
        - qcom,apss-wdt-sm8250
        - qcom,kpss-timer
        - qcom,kpss-wdt
        - qcom,kpss-wdt-apq8064
        - qcom,kpss-wdt-ipq4019
        - qcom,kpss-wdt-ipq8064
        - qcom,kpss-wdt-msm8960
        - qcom,scss-timer
        - qcom,msm-timer  # remove

  reg:
    maxItems: 1

  clocks:
    maxItems: 1

  clock-names:
    maxItems: 1

  interrupts: true

  clock-frequency: true

  cpu-offset: true

required:
  - compatible
  - reg

additionalProperties: false
unevaluatedProperties: false

examples:
  - |
    watchdog@208a038 {
      compatible = "qcom,kpss-wdt-ipq8064";
      reg = <0x0208a038 0x40>;
      clocks = <&sleep_clk>;
      timeout-sec = <10>;
    };
```
