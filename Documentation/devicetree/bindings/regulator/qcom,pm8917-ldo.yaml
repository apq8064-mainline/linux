## Documentation/devicetree/bindings/regulator/qcom,pm8917-ldo.yaml
```yaml
# SPDX-License-Identifier: (GPL-2.0-only OR BSD-2-Clause)
%YAML 1.2
---
$id: http://devicetree.org/schemas/regulator/qcom,pm8917-ldo.yaml#
$schema: http://devicetree.org/meta-schemas/core.yaml#

title: Qualcomm PM8917 direct-control LDO regulators

maintainers:
  - Alexandre MINETTE <contact@alex-min.fr>

description:
  PM8917 provides additional LDOs controlled directly through SSBI instead
  of RPM. L33 supplies 1.2 V and L34 supplies 2.2 V on the supported board.

allOf:
  - $ref: regulator.yaml#

properties:
  compatible:
    enum:
      - qcom,pm8917-l33
      - qcom,pm8917-l34

required:
  - compatible

unevaluatedProperties: false

examples:
  - |
    regulator-l34 {
        compatible = "qcom,pm8917-l34";
        regulator-name = "8917_l34";
        regulator-min-microvolt = <2200000>;
        regulator-max-microvolt = <2200000>;
    };
```

## Documentation/devicetree/bindings/slimbus/qcom,slim.yaml
```yaml
# SPDX-License-Identifier: GPL-2.0 OR BSD-2-Clause
%YAML 1.2
---
$id: http://devicetree.org/schemas/slimbus/qcom,slim.yaml#
$schema: http://devicetree.org/meta-schemas/core.yaml#

title: Qualcomm SoC SLIMbus controller

maintainers:
  - Krzysztof Kozlowski <krzysztof.kozlowski@linaro.org>
  - Srinivas Kandagatla <srinivas.kandagatla@linaro.org>

description:
  SLIMbus controller used when applications processor controls SLIMbus master
  component.

allOf:
  - $ref: slimbus.yaml#

properties:
  compatible:
    items:
      - enum:
          - qcom,apq8064-slim
      - const: qcom,slim

  reg:
    items:
      - description: Physical address of controller register blocks
      - description: SLEW RATE register

  reg-names:
    items:
      - const: ctrl
      - const: slew

  clocks:
    items:
      - description: Interface clock for this controller
      - description: SLIMbus core clock

  clock-names:
    items:
      - const: iface
      - const: core

  dmas:
    minItems: 1
    maxItems: 7
    description: BAM channels for manager playback ports, starting at port 17

  dma-names:
    minItems: 1
    items:
      - const: tx0
      - const: tx1
      - const: tx2
      - const: tx3
      - const: tx4
      - const: tx5
      - const: tx6

  interrupts:
    maxItems: 1

required:
  - compatible
  - reg
  - reg-names
  - clocks
  - clock-names
  - interrupts

unevaluatedProperties: false

examples:
  - |
    #include <dt-bindings/clock/qcom,gcc-msm8960.h>
    #include <dt-bindings/clock/qcom,lcc-msm8960.h>
    #include <dt-bindings/interrupt-controller/arm-gic.h>

    soc {
        #address-cells = <1>;
        #size-cells = <1>;
        ranges;

        slim@28080000 {
            compatible = "qcom,apq8064-slim", "qcom,slim";
            reg = <0x28080000 0x2000>, <0x80207c 4>;
            reg-names = "ctrl", "slew";
            interrupts = <GIC_SPI 33 IRQ_TYPE_LEVEL_HIGH>;
            clocks = <&lcc SLIMBUS_SRC>, <&lcc AUDIO_SLIMBUS_CLK>;
            clock-names = "iface", "core";
            #address-cells = <2>;
            #size-cells = <0>;

            audio-codec@1,0 {
                compatible = "slim217,60";
                reg = <1 0>;
            };
        };
    };
```

## Documentation/devicetree/bindings/sound/qcom,apq8064-tabla.yaml
```yaml
# SPDX-License-Identifier: (GPL-2.0-only OR BSD-2-Clause)
%YAML 1.2
---
$id: http://devicetree.org/schemas/sound/qcom,apq8064-tabla.yaml#
$schema: http://devicetree.org/meta-schemas/core.yaml#

title: Qualcomm APQ8064 with WCD9310 audio

maintainers:
  - Alexandre MINETTE <contact@alex-min.fr>

description:
  Sound card using the APQ8064 Apps-managed SLIMbus controller and a
  WCD9310 tabla2x codec. LINEOUT2/4 drive an external speaker amplifier,
  and the codec directly drives the call earpiece and headphones.

properties:
  compatible:
    const: qcom,apq8064-tabla-snd-card

  model:
    $ref: /schemas/types.yaml#/definitions/string

  codec:
    $ref: /schemas/types.yaml#/definitions/phandle
    description: WCD9310 PGD device on the SLIMbus controller

  hp-det-gpios:
    maxItems: 1
    description: Headphone jack insertion detection

  speaker-en-gpios:
    maxItems: 1
    description: Active-high enable for the external speaker amplifier

required:
  - compatible
  - model
  - codec
  - speaker-en-gpios

additionalProperties: false

examples:
  - |
    #include <dt-bindings/gpio/gpio.h>

    sound {
        compatible = "qcom,apq8064-tabla-snd-card";
        model = "apq8064-tabla";
        codec = <&tabla_codec>;
        speaker-en-gpios = <&pm8921_gpio 18 GPIO_ACTIVE_HIGH>;
    };
```

## Documentation/devicetree/bindings/sound/qcom,wcd9310.yaml
```yaml
# SPDX-License-Identifier: GPL-2.0-only OR BSD-2-Clause
%YAML 1.2
---
$id: http://devicetree.org/schemas/sound/qcom,wcd9310.yaml#
$schema: http://devicetree.org/meta-schemas/core.yaml#

title: Qualcomm WCD9310 Audio Codec

maintainers:
  - Alexandre MINETTE <contact@alex-min.fr>

description: |
  Qualcomm WCD9310 "tabla" Codec is a standalone Hi-Fi audio codec IC
  found on MSM8960/APQ8064 era devices. It is a SLIMbus device with two
  interface elements: the PGD device (reg = <1 0>) used for all codec
  register access, and the interface device (reg = <0 0>) used for
  SLIMbus port configuration registers.

properties:
  compatible:
    const: slim217,60

  reg:
    maxItems: 1

  clocks:
    maxItems: 1

  clock-names:
    const: mclk

  reset-gpios:
    maxItems: 1

  slim-ifc-dev:
    description: phandle to the SLIM interface device node
    $ref: /schemas/types.yaml#/definitions/phandle

  '#sound-dai-cells':
    const: 0

  cdc-vdd-cp-supply:
    description: 1.8V charge pump supply

  cdc-vdda-rx-supply:
    description: RX analog supply

  cdc-vdda-tx-supply:
    description: TX analog supply

  vddio-cdc-supply:
    description: 1.8V codec I/O supply

  vddd-cdc-d-supply:
    description: 1.2V codec digital core supply

  cdc-vdda-a-1p2v-supply:
    description: 1.2V codec analog core supply

required:
  - compatible
  - reg

allOf:
  - $ref: dai-common.yaml#
  - if:
      required:
        - slim-ifc-dev
    then:
      required:
        - clocks
        - clock-names
        - reset-gpios
        - slim-ifc-dev
        - '#sound-dai-cells'
        - cdc-vdd-cp-supply
        - cdc-vdda-rx-supply
        - cdc-vdda-tx-supply
        - vddio-cdc-supply
        - vddd-cdc-d-supply
        - cdc-vdda-a-1p2v-supply
    else:
      properties:
        clocks: false
        clock-names: false
        reset-gpios: false
        slim-ifc-dev: false
        '#sound-dai-cells': false
        cdc-vdd-cp-supply: false
        cdc-vdda-rx-supply: false
        cdc-vdda-tx-supply: false
        vddio-cdc-supply: false
        vddd-cdc-d-supply: false
        cdc-vdda-a-1p2v-supply: false

additionalProperties: false

examples:
  - |
    #include <dt-bindings/gpio/gpio.h>

    tabla_ifd: codec@0,0 {
        compatible = "slim217,60";
        reg = <0 0>;
    };

    codec@1,0 {
        compatible = "slim217,60";
        reg = <1 0>;

        clock-names = "mclk";
        clocks = <&lcc 20>;

        reset-gpios = <&pm8921_gpio 38 GPIO_ACTIVE_LOW>;
        slim-ifc-dev = <&tabla_ifd>;
        #sound-dai-cells = <0>;

        cdc-vdd-cp-supply = <&pm8921_s4>;
        cdc-vdda-rx-supply = <&pm8917_l34>;
        cdc-vdda-tx-supply = <&pm8917_l34>;
        vddio-cdc-supply = <&pm8921_s4>;
        vddd-cdc-d-supply = <&pm8921_l25>;
        cdc-vdda-a-1p2v-supply = <&pm8921_l25>;
    };
```
